## firmware_camera/sdkconfig.defaults
```kconfig
CONFIG_IDF_TARGET="esp32s3"
CONFIG_ESPTOOLPY_FLASHSIZE_8MB=y
CONFIG_ESPTOOLPY_FLASHSIZE="8MB"
CONFIG_PARTITION_TABLE_CUSTOM=y
CONFIG_PARTITION_TABLE_CUSTOM_FILENAME="partitions.csv"
CONFIG_PARTITION_TABLE_FILENAME="partitions.csv"
CONFIG_COMPILER_OPTIMIZATION_SIZE=y
CONFIG_I2C_ENABLE_SLAVE_DRIVER_VERSION_2=n
CONFIG_SPIRAM=y
CONFIG_SPIRAM_MODE_OCT=y
CONFIG_SPIRAM_SPEED_80M=y
CONFIG_CAMERA_PSRAM_DMA=y
```

## firmware_esp32/main/Kconfig.projbuild
```kconfig
menu "StrokeGuard M1a/M1b Config"

    config STROKEGUARD_WIFI_SSID
        string "WiFi SSID"
        default "YOUR_SSID"
        help
            SSID for CSI collection AP. Fixed 2.4GHz Ch6 20MHz recommended.

    config STROKEGUARD_WIFI_PASSWORD
        string "WiFi Password"
        default "YOUR_PASS"
        help
            WPA2-PSK password.

    config STROKEGUARD_DEVICE_ID
        string "Device ID"
        default "sg-0001"

    config STROKEGUARD_MQTT_URI
        string "MQTT broker URI"
        default ""

    config STROKEGUARD_MQTT_USERNAME
        string "MQTT device username"
        default ""

    config STROKEGUARD_MQTT_PASSWORD
        string "MQTT device password"
        default ""

    config STROKEGUARD_PROFILE_AGE
        int "Profile age"
        range 0 130
        default 0

    config STROKEGUARD_PROFILE_GENDER
        string "Profile gender: M, F, or other"
        default "other"

    config STROKEGUARD_MANAGER_PORT
        int "LAN management HTTP port"
        range 1 65535
        default 80

    config STROKEGUARD_MANAGER_TOKEN
        string "LAN management token (local provisioning only)"
        default ""

    config STROKEGUARD_LEGACY_USB_STREAM
        bool "Enable legacy synthetic USB media stream"
        default n
        help
            Development-only compatibility stream. Keep disabled during
            standalone operation and all privacy acceptance tests.

    menu "M1b hardware scaffold"

        config STROKEGUARD_CAMERA_COPROCESSOR_ENABLE
            bool "Enable ESP32-S3-Cam I2C coprocessor"
            default n

        config STROKEGUARD_NMO432_ENABLE
            bool "Enable NMO432 microphone capture"
            default n

        config STROKEGUARD_HW_DISPLAY_ENABLE
            bool "Enable ST7789 TFT display"
            default n
            help
                Disabled until the ST7789 SPI pins are confirmed.

        config STROKEGUARD_HW_AUDIO_OUT_ENABLE
            bool "Enable MAX98357A audio output"
            default n
            help
                Disabled until the MAX98357A I2S pins are confirmed.

        config STROKEGUARD_HW_ALERT_ENABLE
            bool "Enable RGB LED, buzzer, and buttons"
            default n
            help
                Disabled until RGB LED, buzzer, and button pins are confirmed.

        config STROKEGUARD_CAMERA_I2C_SDA
            int "Camera coprocessor I2C SDA GPIO"
            range 0 48
            default 8

        config STROKEGUARD_CAMERA_I2C_SCL
            int "Camera coprocessor I2C SCL GPIO"
            range 0 48
            default 9

        config STROKEGUARD_CAMERA_I2C_ADDRESS
            hex "Camera coprocessor I2C address"
            range 0x08 0x77
            default 0x42

        config STROKEGUARD_NMO432_BCLK
            int "NMO432 SCK/BCLK GPIO"
            range 0 48
            default 17

        config STROKEGUARD_NMO432_WS
            int "NMO432 WS/LRCLK GPIO"
            range 0 48
            default 18

        config STROKEGUARD_NMO432_DIN
            int "NMO432 SD/DIN GPIO"
            range 0 48
            default 16

        config STROKEGUARD_NMO432_CHANNEL_LEFT
            bool "NMO432 outputs on left I2S slot"
            default y

        config STROKEGUARD_PIN_ST7789_MOSI
            int "ST7789 MOSI GPIO (-1 = unassigned)"
            default -1

        config STROKEGUARD_PIN_ST7789_SCLK
            int "ST7789 SCLK GPIO (-1 = unassigned)"
            default -1

        config STROKEGUARD_PIN_ST7789_CS
            int "ST7789 CS GPIO (-1 = unassigned)"
            default -1

        config STROKEGUARD_PIN_ST7789_DC
            int "ST7789 DC GPIO (-1 = unassigned)"
            default -1

        config STROKEGUARD_PIN_ST7789_RST
            int "ST7789 RST GPIO (-1 = unassigned)"
            default -1

        config STROKEGUARD_PIN_ST7789_BL
            int "ST7789 backlight GPIO (-1 = unassigned)"
            default -1

        config STROKEGUARD_PIN_MAX98357_BCLK
            int "MAX98357A BCLK GPIO (-1 = unassigned)"
            default -1

        config STROKEGUARD_PIN_MAX98357_LRC
            int "MAX98357A LRC GPIO (-1 = unassigned)"
            default -1

        config STROKEGUARD_PIN_MAX98357_DIN
            int "MAX98357A DIN GPIO (-1 = unassigned)"
            default -1

        config STROKEGUARD_PIN_ALERT_RGB
            int "RGB LED data GPIO (-1 = unassigned)"
            default -1

        config STROKEGUARD_PIN_ALERT_BUZZER
            int "active buzzer GPIO (-1 = unassigned)"
            default -1

        config STROKEGUARD_PIN_BUTTON_1
            int "button 1 GPIO (-1 = unassigned)"
            default -1

        config STROKEGUARD_PIN_BUTTON_2
            int "button 2 GPIO (-1 = unassigned)"
            default -1

        config STROKEGUARD_PIN_BUTTON_3
            int "button 3 GPIO (-1 = unassigned)"
            default -1

    endmenu

endmenu
```

## firmware_esp32/test_apps/e1_core/main/Kconfig.projbuild
```kconfig
menu "StrokeGuard E1 core test configuration"
    config STROKEGUARD_DEVICE_ID
        string
        default "sg-unit"
    config STROKEGUARD_MQTT_URI
        string
        default ""
    config STROKEGUARD_MQTT_USERNAME
        string
        default ""
    config STROKEGUARD_MQTT_PASSWORD
        string
        default ""
    config STROKEGUARD_PROFILE_AGE
        int
        default 0
    config STROKEGUARD_PROFILE_GENDER
        string
        default "other"
    config STROKEGUARD_MANAGER_PORT
        int
        default 80
    config STROKEGUARD_MANAGER_TOKEN
        string
        default "unit-token"
endmenu
```

## firmware_esp32/test_apps/e1_core/sdkconfig.defaults
```kconfig
CONFIG_IDF_TARGET="esp32s3"
CONFIG_ESPTOOLPY_FLASHSIZE_16MB=y
CONFIG_ESPTOOLPY_FLASHSIZE="16MB"
CONFIG_ESP_CONSOLE_USB_SERIAL_JTAG=y
CONFIG_ESP_CONSOLE_USB_SERIAL_JTAG_ENABLED=y
```
